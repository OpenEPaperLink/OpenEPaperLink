#include "eeprom.h"
#include "chars.h"
#include "mz100_flash.h"
#include "epd.h"

#define NUM_CHARS 256

#define CANVAS_FLIP_H 1
#define CANVAS_MSB_FIRST 1

const static uint8_t mCharsImgs[];

extern uint8_t mScreenRow[];
static void charsPrvDrawCharRow(uint8_t ch, int16_t x, uint8_t imgRow, uint8_t foreColor, uint8_t backColor, uint8_t mag)
{
	uint8_t c, mc, charRow = imgRow / mag, bitMask = (1 << 4) - 1;

	for (c = 0; c < CHAR_WIDTH; c++)
	{ // iterate over the char's columns for this row

		uint8_t imgCol = ((uint8_t)((uint8_t)CHAR_WIDTH * (uint8_t)ch) & 7) + c;																								  // sort out where in the row our data begins
		uint8_t color = ((mCharsImgs[(((CHAR_WIDTH * NUM_CHARS + 7) / 8 * charRow) + (CHAR_WIDTH * ch) / 8) + (imgCol >> 3)] >> (7 - (imgCol % 8))) & 1) ? foreColor : backColor; // get the color

		if (color == CHAR_COLOR_TRANSPARENT)
			continue;

		for (mc = 0; mc < mag; mc++, x++)
		{ // set the pixel

			uint8_t *dst = mScreenRow;
			uint8_t bitOfst;
			uint16_t c = x;

			if (x < 0)
				continue;
			if (x >= DISPLAY_WIDTH)
				break;

#if CANVAS_FLIP_H
			c = DISPLAY_WIDTH - c - 1;
#endif

			dst += (c * 4) / 8;
			bitOfst = (c * 4) % 8;

#if CANVAS_MSB_FIRST
			bitOfst = 8 - bitOfst - 4;
#endif

			*dst = ((*dst) & ~(bitMask << bitOfst)) | ((color & bitMask) << bitOfst);
		}
	}
}

void charsDrawString(const struct CharDrawingParams *params)
{
	const char *s = params->str;
	int16_t x = params->x;
	uint8_t ch;

	while ((ch = *s++) != 0)
	{
		charsPrvDrawCharRow(ch, x, params->imgRow, params->foreColor, params->backColor, params->magnify);
		x += (uint16_t)(uint8_t)(CHAR_WIDTH * params->magnify);
	}
}

const static uint8_t mCharsImgs[] = {
	0x00, 0x00, 0x00, 0x00, 0x02, 0x00, 0x00, 0x00, 0x00, 0x00, 0x00, 0x00,
	0x00, 0x00, 0x00, 0x00, 0x00, 0x00, 0x00, 0x00, 0x00, 0x00, 0x00, 0x00,
	0x00, 0x00, 0x00, 0x00, 0x00, 0x00, 0x00, 0x00, 0x00, 0x00, 0x00, 0x00,
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	0x00, 0x00, 0x00, 0x00};